/ {
    kscan {
        compatible = "zmk,kscan-gpio-direct";
        input-gpios =
            <&gpio0 2 (GPIO_ACTIVE_LOW | GPIO_PULL_UP)>,
            <&gpio0 3 (GPIO_ACTIVE_LOW | GPIO_PULL_UP)>,
            <&gpio0 4 (GPIO_ACTIVE_LOW | GPIO_PULL_UP)>;
    };
};
