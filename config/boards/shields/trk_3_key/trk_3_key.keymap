/ {
    keymap {
        compatible = "zmk,keymap";

        default_layer {
            bindings = <
                &kp Q
                &kp W
                &kp E
            >;
        };
    };
};
