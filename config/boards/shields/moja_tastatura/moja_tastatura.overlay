/*
 * Moja handwire tastatura - 3 tastera, direct pin, Nice Nano
 *
 * Svaki taster je vezan: jedan kraj na GPIO pin, drugi na GND.
 * Nema dioda, nema matrice.
 *
 * Pinovi (pro_micro numeracija za Nice Nano):
 *   Taster 1 -> pro_micro pin 4  (P0.22 na Nice Nano)
 *   Taster 2 -> pro_micro pin 5  (P0.24 na Nice Nano)
 *   Taster 3 -> pro_micro pin 6  (P0.09 na Nice Nano)
 *
 * Da promenis pin: zameni broj u input-gpios linijama ispod.
 * Referenca pinova: https://nicekeyboards.com/docs/nice-nano/pinout-schematic
 */

#include <dt-bindings/zmk/matrix_transform.h>

/ {
    chosen {
        zmk,kscan = &kscan0;
        zmk,matrix-transform = &default_transform;
    };

    /* ----- Keyboard scan: direct pin (bez matrice, bez dioda) ----- */
    kscan0: kscan {
        compatible = "zmk,kscan-gpio-direct";
        wakeup-source;

        input-gpios
            = <&pro_micro 4 (GPIO_ACTIVE_LOW | GPIO_PULL_UP)>   /* Taster 1 */
            , <&pro_micro 5 (GPIO_ACTIVE_LOW | GPIO_PULL_UP)>   /* Taster 2 */
            , <&pro_micro 6 (GPIO_ACTIVE_LOW | GPIO_PULL_UP)>   /* Taster 3 */
            ;
    };

    /* ----- Matrix transform: 1 red, 3 kolone ----- */
    default_transform: matrix_transform {
        compatible = "zmk,matrix-transform";
        rows = <1>;
        columns = <3>;

        /* RC(red, kolona) -> pozicija tastera u keymap-i */
        map = <
            RC(0,0)  RC(0,1)  RC(0,2)
        >;
    };
};
