#include <physical_layouts.dtsi>

/ {
    physical_layout_trk_3_key: physical_layout_trk_3_key {
        compatible = "zmk,physical-layout";
        display-name = "trk 3 key";
        keys  //                     w   h    x    y     rot    rx    ry
            = <&key_physical_attrs 100 100  100    0       0   100     0>
            , <&key_physical_attrs 100 100  200    0       0   200     0>
            , <&key_physical_attrs 100 100  300    0       0   300     0>
            ;
    };
};
