#include "trk_3_key-layouts.dtsi"
#include <dt-bindings/zmk/matrix_transform.h>

/ {
    matrix_transform0: matrix_transform0 {
        compatible = "zmk,matrix-transform";
        columns = <3>;
        rows = <3>;
        map = <
            RC(0,1) RC(1,2) RC(2,0)
        >;
    };
};

&physical_layout_trk_3_key {
    transform = <&matrix_transform0>;
};

