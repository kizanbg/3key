## boards/shields/trk_3_key/Kconfig.defconfig
```kconfig
if SHIELD_TRK_3_KEY

# Name must be less than 16 characters long!
config ZMK_KEYBOARD_NAME
    default "trk 3 key"

endif
```

## config/boards/shields/moja_tastatura/Kconfig.defconfig
```kconfig
if SHIELD_MOJA_TASTATURA

config ZMK_KEYBOARD_NAME
    default "Moja Tastatura"

endif
```

## config/boards/shields/moja_tastatura/Kconfig.shield
```kconfig
config SHIELD_MOJA_TASTATURA
    def_bool $(shields_list_contains,moja_tastatura)
```
